## contrib/board/olimex/sam9_l9260/sam9_l9260_uboot_defconfig
```kconfig
CONFIG_SAM9_L9260=y
CONFIG_SPI_BOOT_CS1=y
CONFIG_THUMB=y
CONFIG_IMG_ADDRESS="0x00008400"
CONFIG_DEBUG=y
# CONFIG_CONFIG_DATAFLASH_RECOVERY is not set
```
